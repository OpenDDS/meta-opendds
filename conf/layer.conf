## conf/layer.conf
```bitbake
# We have a conf and classes directory, add to BBPATH
BBPATH .= ":${LAYERDIR}"

# We have recipes-* directories, add to BBFILES
BBFILES += "${LAYERDIR}/recipes-*/*/*.bb \
            ${LAYERDIR}/recipes-*/*/*.bbappend"

BBFILE_COLLECTIONS += "opendds-layer"
BBFILE_PATTERN_opendds-layer = "^${LAYERDIR}/"
BBFILE_PRIORITY_opendds-layer = "6"

LAYERSERIES_COMPAT_opendds-layer = "kirkstone nanbield scarthgap styhead"
LAYERDEPENDS_opendds-layer = "core"

LICENSE_PATH += "${LAYERDIR}/licenses"
```
